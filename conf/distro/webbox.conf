## conf/distro/webbox.conf
```bitbake
DISTRO = "webbox"
DISTRO_NAME = "webbox-weston-poky"
DISTRO_VERSION = "1.0"

# Image is based on Poky
include conf/distro/poky.conf

# GUI is based on wayland/weston
DISTRO_FEATURES:append = " wayland"

# Use systemd as init manager, pam for weston user
DISTRO_FEATURES:append = " pam systemd"
DISTRO_FEATURES_BACKFILL_CONSIDERED += "sysvinit"
VIRTUAL-RUNTIME_init_manager = "systemd"
VIRTUAL-RUNTIME_initscripts = "systemd-compat-units"

# Audio middleware
DISTRO_FEATURES:append = " pulseaudio"

# Disable test apps
BBMASK += "qapp"

# Video and audio codecs for VLC
LICENSE_FLAGS_WHITELIST = "commercial"
```

## conf/layer.conf
```bitbake
# We have a conf and classes directory, add to BBPATH
BBPATH .= ":${LAYERDIR}"

# We have recipes-* directories, add to BBFILES
BBFILES += "${LAYERDIR}/recipes-*/*/*.bb \
            ${LAYERDIR}/recipes-*/*/*.bbappend \
"

BBFILE_COLLECTIONS += "meta-minimindgames"
BBFILE_PATTERN_meta-minimindgames = "^${LAYERDIR}/"
BBFILE_PRIORITY_meta-minimindgames = "6"

LAYERDEPENDS_meta-minimindgames = "core"
LAYERSERIES_COMPAT_meta-minimindgames = "honister"
```
